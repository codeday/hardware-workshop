//#--------------------------------------------------------------------------------------#
//| Thanks to Digikey for providing the kits and helping us make this an amazing CodeDay!|
//#--------------------------------------------------------------------------------------#
#include <U8g2lib.h> //Library for the screen
#include <Wire.h> //For I2C (How the display and board talk to each other)
#include <Arduino.h> //required for screen, idk what rn

static const unsigned char owo1_bits[] PROGMEM = {
   0x00, 0x00, 0x00, 0x00, 0x00, 0x00, 0x00, 0x00, 0x00, 0x00, 0x00, 0x00,
   0x00, 0x00, 0x00, 0x00, 0x00, 0x00, 0x00, 0x00, 0x00, 0x00, 0x00, 0x00,
   0x00, 0x00, 0x00, 0x00, 0x00, 0x00, 0x00, 0x00, 0x00, 0x00, 0x00, 0x00,
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   0x00, 0x00, 0x00, 0x00 };
static const unsigned char owo2_bits[] PROGMEM = {
   0x00, 0x00, 0x00, 0x00, 0x00, 0x00, 0x00, 0x00, 0x00, 0x00, 0x00, 0x00,
   0x00, 0x00, 0x00, 0x00, 0x00, 0x00, 0x00, 0x00, 0x00, 0x00, 0x00, 0x00,
   0x00, 0x00, 0x00, 0x00, 0x00, 0x00, 0x00, 0x00, 0x00, 0x00, 0x00, 0x00,
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   0x00, 0x00, 0x00, 0x00 };
static const unsigned char owo3_bits[] PROGMEM = {
   0x00, 0x00, 0x00, 0x00, 0x00, 0x00, 0x00, 0x00, 0x00, 0x00, 0x00, 0x00,
   0x00, 0x00, 0x00, 0x00, 0x00, 0x00, 0x00, 0x00, 0x00, 0x00, 0x00, 0x00,
   0x00, 0x00, 0x00, 0x00, 0x00, 0x00, 0x00, 0x00, 0x00, 0x00, 0x00, 0x00,
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   0x00, 0x00, 0x00, 0x00 };
//Board pin numbers and other variables
char led = 4;
char buzzer = 5;
bool hatched = false; //to store if the egg has hatched
int millis_since_press = 0;
char button = 6;
U8G2_SSD1306_128X64_NONAME_F_HW_I2C u8g2(U8G2_R0, /* clock=*/ SCL, /* data=*/ SDA, /* reset=*/ U8X8_PIN_NONE); 

void drawSmallEgg(){
  u8g2.clearBuffer(); //Clears the screen
  u8g2.drawCircle(63,31,20); //sad excuse for an egg but works
  u8g2.sendBuffer(); //Sends image to the screen
  delay(750);
}
void drawBigEgg() {
  u8g2.clearBuffer(); //Clears the screen
  u8g2.drawCircle(63,31,15); //sad excuse for an egg but works
  u8g2.sendBuffer(); //Sends image to screen
  delay(750);
}
void drawOwO1(void) {
  u8g2.drawXBMP(32,16,64,32, owo1_bits);
}
void drawOwO2(void) {
  u8g2.drawXBMP(32,16,64,32, owo2_bits);
}
void drawOwO3(void) {
  u8g2.drawXBMP(32,16,64,32, owo3_bits);
}
void setup() {
  u8g2.begin(); //Tells the screen to start
  u8g2.clearBuffer(); //Clears the screen
  u8g2.setFont(u8g2_font_ncenB08_tr); //Sets the font the screen uses
  while (digitalRead(button) == LOW) {
    u8g2.clearBuffer(); //Clears the screen
    u8g2.drawStr(30,20,"JojiGotchi"); //Title screen
    u8g2.drawStr(25,45,"Press Any Button");
    u8g2.sendBuffer();
  }
  millis_since_press = millis();
  while (millis() - millis_since_press <= 300000) { //checks if hatching time is less than 5 mins, if its more than 5 the loop ends and the Jojigotchi hatches
    drawSmallEgg();
    drawBigEgg();
  }
}

void loop(void) {
  //Shows different OwO faces every 10s
  u8g2.firstPage();
  do {
    drawOwO1();
  } while(u8g2.nextPage());
  delay(10000);
  u8g2.firstPage();
  do {
    drawOwO2();
  } while(u8g2.nextPage());
  delay(10000);
  u8g2.firstPage();
  do {
    drawOwO3();
  } while(u8g2.nextPage());
  delay(10000);
}
